## examples/esp32c6-apptrace-test/sdkconfig.defaults
```kconfig
# ESP32-C6 Apptrace Test Configuration
# ======================================
# This config enables high-speed trace streaming via OpenOCD JTAG interface
#
# CRITICAL for RISC-V ESP chips (C6, C3, H2, C5):
# - Chip must boot AFTER OpenOCD connects (semihosting handshake)
# - Start apptrace within 1-2 seconds of reset
# - Use poll_period >= 1ms in OpenOCD command
#
# See: https://github.com/espressif/openocd-esp32/issues/188
#      https://github.com/espressif/esp-idf/issues/18213

CONFIG_IDF_TARGET="esp32c6"
CONFIG_ESPTOOLPY_FLASHSIZE_4MB=y
CONFIG_ESP_DEFAULT_CPU_FREQ_MHZ_160=y

# USB Serial/JTAG console (for regular debug output via ESP_LOGI)
# ESP32-C6 has built-in USB-JTAG supporting BOTH debug and serial console
# This does NOT conflict with apptrace - both work simultaneously
# Alternative: CONFIG_ESP_CONSOLE_UART=y (requires external USB-UART adapter)
CONFIG_ESP_CONSOLE_USB_SERIAL_JTAG=y

# Application trace via JTAG (for high-speed trace streaming)
# Enables esp_app_trace.h API and internal ring buffer
# On RISC-V, triggers semihosting call during boot to advertise buffer to OpenOCD
# JTAG destination is faster than UART and doesn't interfere with console
CONFIG_APPTRACE_DEST_JTAG=y
CONFIG_APPTRACE_ENABLE=y
```

## examples/esp32c6-ble-gateway/sdkconfig.defaults
```kconfig
# Target
CONFIG_IDF_TARGET="esp32c6"
CONFIG_ESPTOOLPY_FLASHSIZE_4MB=y
CONFIG_ESP_DEFAULT_CPU_FREQ_MHZ_160=y

# Console via USB Serial/JTAG
CONFIG_ESP_CONSOLE_USB_SERIAL_JTAG=y

# BLE (NimBLE)
CONFIG_BT_ENABLED=y
CONFIG_BT_NIMBLE_ENABLED=y
CONFIG_BT_NIMBLE_MAX_CONNECTIONS=1

# UART for MCXN947 data link
CONFIG_UART_ISR_IN_IRAM=y
```

## examples/esp32c6-test-firmware/sdkconfig.defaults
```kconfig
# Minimal config for ESP32-C6
CONFIG_IDF_TARGET="esp32c6"
CONFIG_ESPTOOLPY_FLASHSIZE_4MB=y
CONFIG_ESP_DEFAULT_CPU_FREQ_MHZ_160=y
CONFIG_ESP_CONSOLE_USB_SERIAL_JTAG=y
```

## examples/esp32p4-stress-test/sdkconfig.defaults
```kconfig
# ESP32-P4 specific config
CONFIG_IDF_TARGET="esp32p4"

# USB Serial/JTAG Console
CONFIG_ESP_CONSOLE_USB_SERIAL_JTAG=y
CONFIG_ESP_CONSOLE_SECONDARY_NONE=y

# Logging
CONFIG_LOG_DEFAULT_LEVEL_INFO=y
CONFIG_LOG_MAXIMUM_LEVEL_VERBOSE=y

# FreeRTOS
CONFIG_FREERTOS_HZ=1000
CONFIG_FREERTOS_UNICORE=n

# Performance
CONFIG_COMPILER_OPTIMIZATION_PERF=y
CONFIG_FREERTOS_ENABLE_BACKWARD_COMPATIBILITY=y
```

## examples/esp32s3-debug-full/sdkconfig.defaults
```kconfig
# ESP32-S3 Debug Full Example - Complete Debug Configuration
# Based on ESP-IDF official examples with all debugging features enabled

# ============= FreeRTOS =============
# 1ms tick for better time resolution in traces
CONFIG_FREERTOS_HZ=1000
# Enable FreeRTOS runtime stats
CONFIG_FREERTOS_USE_TRACE_FACILITY=y
CONFIG_FREERTOS_GENERATE_RUN_TIME_STATS=y

# ============= SystemView Tracing =============
CONFIG_ESP_TRACE_ENABLE=y
CONFIG_ESP_TRACE_LIB_EXTERNAL=y
CONFIG_ESP_TRACE_TRANSPORT_APPTRACE=y
CONFIG_ESP_TRACE_TS_SOURCE_ESP_TIMER=y

# Enable all SystemView events for comprehensive tracing
CONFIG_SEGGER_SYSVIEW_EVT_OVERFLOW_ENABLE=y
CONFIG_SEGGER_SYSVIEW_EVT_ISR_ENTER_ENABLE=y
CONFIG_SEGGER_SYSVIEW_EVT_ISR_EXIT_ENABLE=y
CONFIG_SEGGER_SYSVIEW_EVT_ISR_TO_SCHED_ENABLE=y
CONFIG_SEGGER_SYSVIEW_EVT_TASK_START_EXEC_ENABLE=y
CONFIG_SEGGER_SYSVIEW_EVT_TASK_STOP_EXEC_ENABLE=y
CONFIG_SEGGER_SYSVIEW_EVT_TASK_START_READY_ENABLE=y
CONFIG_SEGGER_SYSVIEW_EVT_TASK_STOP_READY_ENABLE=y
CONFIG_SEGGER_SYSVIEW_EVT_TASK_CREATE_ENABLE=y
CONFIG_SEGGER_SYSVIEW_EVT_TASK_TERMINATE_ENABLE=y
CONFIG_SEGGER_SYSVIEW_EVT_IDLE_ENABLE=y
CONFIG_SEGGER_SYSVIEW_EVT_TIMER_ENTER_ENABLE=y
CONFIG_SEGGER_SYSVIEW_EVT_TIMER_EXIT_ENABLE=y

# ============= Heap Tracing =============
CONFIG_HEAP_TRACING=y
CONFIG_HEAP_TRACING_DEST_TRAX=y
CONFIG_HEAP_TRACING_STACK_DEPTH=4

# ============= Coredump =============
CONFIG_ESP_COREDUMP_ENABLE=y
CONFIG_ESP_COREDUMP_DATA_FORMAT_ELF=y
CONFIG_ESP_COREDUMP_CHECKSUM_CRC32=y
CONFIG_ESP_COREDUMP_CAPTURE_DRAM=y
CONFIG_ESP_COREDUMP_MAX_TASKS_NUM=16
# Save to flash (requires coredump partition)
CONFIG_ESP_COREDUMP_TO_FLASH_OR_UART=FLASH

# ============= Stack Protection =============
CONFIG_FREERTOS_WATCHPOINT_END_OF_STACK=y
CONFIG_FREERTOS_CHECK_STACKOVERFLOW_PTRVAL=y

# ============= Task Watchdog =============
CONFIG_ESP_TASK_WDT=y
CONFIG_ESP_TASK_WDT_PANIC=y
CONFIG_ESP_TASK_WDT_TIMEOUT_S=10
CONFIG_ESP_TASK_WDT_CHECK_IDLE_TASK_CPU0=y

# ============= Logging =============
# Default log level
CONFIG_LOG_DEFAULT_LEVEL_INFO=y
CONFIG_LOG_DEFAULT_LEVEL=3

# ============= UART Console =============
CONFIG_ESP_CONSOLE_UART_DEFAULT=y
CONFIG_ESP_CONSOLE_UART_NUM=0
CONFIG_ESP_CONSOLE_UART_BAUDRATE=115200

# ============= Main Task =============
CONFIG_ESP_MAIN_TASK_STACK_SIZE=4096
```
