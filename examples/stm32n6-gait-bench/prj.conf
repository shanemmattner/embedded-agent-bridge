## CMakeLists.txt
```
cmake_minimum_required(VERSION 3.20.0)
find_package(Zephyr REQUIRED HINTS $ENV{ZEPHYR_BASE})
project(stm32n6_gait_bench)

set(NO_THREADSAFE_STATICS $<TARGET_PROPERTY:compiler-cpp,no_threadsafe_statics>)
zephyr_compile_options($<$<COMPILE_LANGUAGE:CXX>:${NO_THREADSAFE_STATICS}>)

target_sources(app PRIVATE
    src/main.cpp
    src/dwt_profiler.c
    src/models/exoboot_gait_model.cpp
)
target_include_directories(app PRIVATE src src/models)
```

## prj.conf
```kconfig
# Console output over UART (captured by EAB serial daemon)
CONFIG_CONSOLE=y
CONFIG_SERIAL=y
CONFIG_UART_CONSOLE=y

# Logging
CONFIG_LOG=y
CONFIG_LOG_PRINTK=y
CONFIG_LOG_PROCESS_THREAD_STARTUP_DELAY_MS=0

# C++ and TFLite Micro
CONFIG_CPP=y
CONFIG_STD_CPP17=y
CONFIG_TENSORFLOW_LITE_MICRO=y
CONFIG_TENSORFLOW_LITE_MICRO_CMSIS_NN_KERNELS=y

# Heap: 64KB (model is 43KB, small working memory)
CONFIG_HEAP_MEM_POOL_SIZE=65536

# Main stack: 32KB for ML inference
CONFIG_MAIN_STACK_SIZE=32768

# FPU
CONFIG_FPU=y
CONFIG_REQUIRES_FLOAT_PRINTF=y

# Disable tracing to reduce overhead for benchmarks
CONFIG_TRACING=n
```

## src/main.cpp
```c
/*
 * STM32N6 Gait Phase Estimator Benchmark
 *
 * Runs the Shepherd Exoboot gait phase model (Georgia Tech EPIC Lab, ICRA 2022)
 * on Cortex-M55 @ 600MHz with DWT cycle counting.
 *
 * Model: Conv1D x3 + 2 Dense heads → gait_phase (0-100%) + stance/swing
 * Input: (1, 44, 8) int8 — 44 timesteps of 8 IMU channels
 * Source: github.com/maxshep/exoboot-ml-gait-state-estimator (Apache 2.0)
 */
#include <zephyr/kernel.h>
#include <string.h>

#include <tensorflow/lite/micro/micro_mutable_op_resolver.h>
#include <tensorflow/lite/micro/micro_interpreter.h>
#include <tensorflow/lite/micro/micro_log.h>
#include <tensorflow/lite/micro/system_setup.h>
#include <tensorflow/lite/schema/schema_generated.h>

extern "C" {
#include "dwt_profiler.h"
}
#include "exoboot_gait_model.h"

#define STM32N6_CPU_FREQ_HZ 600000000

constexpr int kTensorArenaSize = 32 * 1024;
static uint8_t tensor_arena[kTensorArenaSize] __attribute__((aligned(16)));

static void bench_exoboot_gait(void) {
    const tflite::Model *model = tflite::GetModel(g_exoboot_gait_model);
    if (model->version() != TFLITE_SCHEMA_VERSION) {
        printk("ERROR: exoboot_gait model schema mismatch\n");
        return;
    }

    static tflite::MicroMutableOpResolver<7> resolver;
    resolver.AddAdd();
    resolver.AddConv2D();
    resolver.AddExpandDims();
    resolver.AddFullyConnected();
    resolver.AddLogistic();
    resolver.AddMul();
    resolver.AddReshape();

    tflite::MicroInterpreter interpreter(model, resolver, tensor_arena, kTensorArenaSize);
    if (interpreter.AllocateTensors() != kTfLiteOk) {
        printk("ERROR: exoboot_gait AllocateTensors() failed\n");
        return;
    }

    TfLiteTensor *input = interpreter.input(0);

    printk("Model loaded: exoboot_gait (size=%d bytes)\n", g_exoboot_gait_model_len);
    printk("Arena used: %zu / %d bytes\n", interpreter.arena_used_bytes(), kTensorArenaSize);
    printk("Input shape: (%d, %d, %d)\n",
           input->dims->data[0], input->dims->data[1], input->dims->data[2]);
    printk("Input quant: scale=%.6f zero_point=%d\n",
           (double)input->params.scale, input->params.zero_point);

    const int num_inferences = 100;

    /* Warm up with zero input */
    memset(input->data.int8, 0, input->bytes);
    interpreter.Invoke();

    /* Timed run */
    dwt_reset();
    for (int i = 0; i < num_inferences; i++) {
        interpreter.Invoke();
    }
    uint32_t total_cycles = dwt_get_cycles();
    uint32_t avg_cycles = total_cycles / num_inferences;
    uint32_t avg_time_us = dwt_cycles_to_us(avg_cycles, STM32N6_CPU_FREQ_HZ);

    printk("[ML_BENCH] model=exoboot_gait backend=cmsis_nn cycles=%u time_us=%u input=%u ops=INT8 inferences=%d\n",
           avg_cycles, avg_time_us, (unsigned)input->bytes, num_inferences);

    /* Dequantize and print both output heads */
    TfLiteTensor *out_phase = interpreter.output(0);
    TfLiteTensor *out_stance = interpreter.output(1);

    float gait_phase = (out_phase->data.int8[0] - out_phase->params.zero_point) * out_phase->params.scale;
    float stance_swing = (out_stance->data.int8[0] - out_stance->params.zero_point) * out_stance->params.scale;

    printk("Output[0] gait_phase:   %.4f (%.1f%%)\n", (double)gait_phase, (double)(gait_phase * 100.0f));
    printk("Output[1] stance_swing: %.4f\n\n", (double)stance_swing);
}

int main(void) {
    /* Delay to allow serial reader to connect after SRAM boot.
     * probe-rs holds the USB device during GDB boot — serial reader
     * can only open after probe-rs releases it (~2-3s). */
    k_msleep(5000);

    printk("=== STM32N6 Gait Phase Benchmark (NUCLEO-N657X0-Q) ===\n");
    printk("Board: NUCLEO-N657X0-Q\n");
    printk("CPU Frequency: %u Hz\n", STM32N6_CPU_FREQ_HZ);
    printk("Arena: %d bytes (%d KB)\n\n", kTensorArenaSize, kTensorArenaSize / 1024);

    dwt_init();
    printk("DWT profiler initialized\n\n");

    bench_exoboot_gait();

    printk("[ML_BENCH_DONE] board=nucleo_n657x0_q models=1\n");

    while (1) {
        k_msleep(1000);
    }
    return 0;
}
```

## src/dwt_profiler.c
```c
#include "dwt_profiler.h"
```

## src/dwt_profiler.h
```c
#ifndef DWT_PROFILER_H
#define DWT_PROFILER_H

#include <stdint.h>

/* ARM DWT registers */
#define DWT_CTRL   (*(volatile uint32_t *)0xE0001000)
#define DWT_CYCCNT (*(volatile uint32_t *)0xE0001004)
#define DEM_CR     (*(volatile uint32_t *)0xE000EDFC)

/* Enable DWT cycle counter */
static inline void dwt_init(void) {
    DEM_CR |= (1 << 24);      /* TRCENA bit in DEMCR */
    DWT_CYCCNT = 0;
    DWT_CTRL |= 1;            /* CYCCNTENA */
}

static inline void dwt_reset(void) {
    DWT_CTRL &= ~1;           /* Disable counter */
    DWT_CYCCNT = 0;
    DWT_CTRL |= 1;            /* Re-enable counter */
}

static inline uint32_t dwt_get_cycles(void) {
    return DWT_CYCCNT;
}

/* Convert cycles to microseconds given CPU freq in Hz */
static inline uint32_t dwt_cycles_to_us(uint32_t cycles, uint32_t cpu_freq_hz) {
    return (uint32_t)((uint64_t)cycles * 1000000ULL / cpu_freq_hz);
}

#endif
```
