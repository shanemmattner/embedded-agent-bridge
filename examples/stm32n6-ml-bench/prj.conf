## CMakeLists.txt
```
cmake_minimum_required(VERSION 3.20.0)
find_package(Zephyr REQUIRED HINTS $ENV{ZEPHYR_BASE})
project(stm32n6_ml_bench)

set(NO_THREADSAFE_STATICS $<TARGET_PROPERTY:compiler-cpp,no_threadsafe_statics>)
zephyr_compile_options($<$<COMPILE_LANGUAGE:CXX>:${NO_THREADSAFE_STATICS}>)

target_sources(app PRIVATE
    src/main.cpp
    src/ml_bench.cpp
    src/dwt_profiler.c
    src/models/sine_model.cpp
    src/models/micro_speech_model.cpp
    src/models/person_detect_model.cpp
)
target_include_directories(app PRIVATE src src/models)
```

## prj.conf
```kconfig
# Console output over UART (captured by EAB serial daemon)
CONFIG_CONSOLE=y
CONFIG_SERIAL=y
CONFIG_UART_CONSOLE=y

# Logging
CONFIG_LOG=y
CONFIG_LOG_PRINTK=y
CONFIG_LOG_PROCESS_THREAD_STARTUP_DELAY_MS=0

# C++ and TFLite Micro
CONFIG_CPP=y
CONFIG_STD_CPP17=y
CONFIG_TENSORFLOW_LITE_MICRO=y
CONFIG_TENSORFLOW_LITE_MICRO_CMSIS_NN_KERNELS=y

# Heap: 128KB for ML buffers
CONFIG_HEAP_MEM_POOL_SIZE=131072

# Main stack: 32KB for ML inference
CONFIG_MAIN_STACK_SIZE=32768

# FPU
CONFIG_FPU=y
CONFIG_REQUIRES_FLOAT_PRINTF=y

# Disable tracing to reduce overhead for benchmarks
CONFIG_TRACING=n
```

## boards/nucleo_n657x0_q.overlay
```dts
/* Use axisram1 (1024KB) instead of axisram2 (511KB) for ML bench.
 * person_detect model (~300KB) + 140KB arena needs more than 511KB.
 * Flash address changes from 0x34180400 to 0x34000000.
 */
/ {
	chosen {
		zephyr,sram = &axisram1;
	};
};
```

## src/main.c
```c
#include <zephyr/kernel.h>
#include <stdio.h>
#include "dwt_profiler.h"
#include "ml_bench.h"

int main(void) {
    /* Print banner */
    printk("=== STM32N6 ML Benchmark (STM32N6570-DK) ===\n");
    printk("Board: STM32N6570-DK\n");
    printk("CPU Frequency: %u Hz\n", STM32N6_CPU_FREQ_HZ);
    printk("\n");

    /* Initialize DWT cycle counter */
    dwt_init();
    printk("DWT profiler initialized\n\n");

    /* Run benchmarks for placeholder models */
    ml_bench_result_t results[3];

    /* cifar10: 32*32*3 = 3072 input bytes, 50000 model bytes, 100 iterations */
    results[0] = ml_bench_run_dummy("cifar10", 32 * 32 * 3, 50000, 100);

    /* person_detect: 96*96*1 = 9216 input bytes, 300000 model bytes, 50 iterations */
    results[1] = ml_bench_run_dummy("person_detect", 96 * 96 * 1, 300000, 50);

    /* micro_speech: 49*40 = 1960 input bytes, 20000 model bytes, 200 iterations */
    results[2] = ml_bench_run_dummy("micro_speech", 49 * 40, 20000, 200);

    /* Print detailed results */
    for (int i = 0; i < 3; i++) {
        ml_bench_print_result(&results[i]);
    }

    /* Print summary table */
    printk("\n");
    ml_bench_print_header();
    for (int i = 0; i < 3; i++) {
        ml_bench_print_row(&results[i]);
    }
    printk("\n");

    /* Print completion marker */
    printk("[ML_BENCH_DONE] board=nucleo_n657x0q models=3\n");

    /* Enter idle loop */
    while (1) {
        k_msleep(1000);
    }

    return 0;
}
```

## src/main.cpp
```c
#include <zephyr/kernel.h>
#include <string.h>

#include <tensorflow/lite/micro/micro_mutable_op_resolver.h>
#include <tensorflow/lite/micro/micro_interpreter.h>
#include <tensorflow/lite/micro/micro_log.h>
#include <tensorflow/lite/micro/system_setup.h>
#include <tensorflow/lite/schema/schema_generated.h>

extern "C" {
#include "dwt_profiler.h"
}
#include "ml_bench.h"
#include "sine_model.h"
#include "micro_speech_model.h"
#include "person_detect_model.h"

/* Tensor arena shared across models — 140KB for person_detect */
constexpr int kTensorArenaSize = 140 * 1024;
static uint8_t tensor_arena[kTensorArenaSize] __attribute__((aligned(16)));

static void bench_sine(void) {
    const tflite::Model *model = tflite::GetModel(g_sine_model);
    if (model->version() != TFLITE_SCHEMA_VERSION) {
        printk("ERROR: sine model schema mismatch\n");
        return;
    }

    static tflite::MicroMutableOpResolver<1> resolver;
    resolver.AddFullyConnected();

    tflite::MicroInterpreter interpreter(model, resolver, tensor_arena, kTensorArenaSize);
    if (interpreter.AllocateTensors() != kTfLiteOk) {
        printk("ERROR: sine AllocateTensors() failed\n");
        return;
    }

    TfLiteTensor *input = interpreter.input(0);
    TfLiteTensor *output = interpreter.output(0);

    printk("Model loaded: sine (size=%d bytes)\n", g_sine_model_len);
    printk("Arena used: %zu / %d bytes\n", interpreter.arena_used_bytes(), kTensorArenaSize);

    const int num_inferences = 100;

    /* Warm up */
    input->data.int8[0] = 0;
    interpreter.Invoke();

    /* Timed run — re-init DWT in case something disabled it */
    dwt_init();
    uint32_t t0 = dwt_start();
    for (int i = 0; i < num_inferences; i++) {
        float x = (float)i / (float)num_inferences * 6.28318f;
        int8_t x_q = (int8_t)(x / input->params.scale + input->params.zero_point);
        input->data.int8[0] = x_q;
        interpreter.Invoke();
    }
    uint32_t total_cycles = dwt_stop(t0);
    uint32_t avg_cycles = total_cycles / num_inferences;
    uint32_t avg_time_us = dwt_cycles_to_us(avg_cycles, STM32N6_CPU_FREQ_HZ);

    printk("[ML_BENCH] model=sine backend=cmsis_nn cycles=%u time_us=%u input=1 ops=INT8 inferences=%d\n",
           avg_cycles, avg_time_us, num_inferences);

    int8_t y_q = output->data.int8[0];
    float y = (y_q - output->params.zero_point) * output->params.scale;
    printk("Last inference: sin(~6.28) = %.4f (expected ~0.0)\n\n", (double)y);
}

static void bench_person_detect(void) {
    const tflite::Model *model = tflite::GetModel(g_person_detect_model);
    if (model->version() != TFLITE_SCHEMA_VERSION) {
        printk("ERROR: person_detect model schema mismatch\n");
        return;
    }

    static tflite::MicroMutableOpResolver<5> resolver;
    resolver.AddAveragePool2D();
    resolver.AddConv2D();
    resolver.AddDepthwiseConv2D();
    resolver.AddReshape();
    resolver.AddSoftmax();

    tflite::MicroInterpreter interpreter(model, resolver, tensor_arena, kTensorArenaSize);
    if (interpreter.AllocateTensors() != kTfLiteOk) {
        printk("ERROR: person_detect AllocateTensors() failed\n");
        return;
    }

    TfLiteTensor *input = interpreter.input(0);

    printk("Model loaded: person_detect (size=%d bytes)\n", g_person_detect_model_len);
    printk("Arena used: %zu / %d bytes\n", interpreter.arena_used_bytes(), kTensorArenaSize);
    printk("Input shape: %dx%dx%d\n", input->dims->data[1], input->dims->data[2], input->dims->data[3]);

    memset(input->data.int8, 0, input->bytes);
    interpreter.Invoke();

    const int num_iters = 10;
    dwt_init();
    uint32_t t0 = dwt_start();
    for (int i = 0; i < num_iters; i++) {
        interpreter.Invoke();
    }
    uint32_t total_cycles = dwt_stop(t0);
    uint32_t avg_cycles = total_cycles / num_iters;
    uint32_t avg_time_us = dwt_cycles_to_us(avg_cycles, STM32N6_CPU_FREQ_HZ);

    printk("[ML_BENCH] model=person_detect backend=cmsis_nn cycles=%u time_us=%u input=%u ops=INT8 inferences=%d\n",
           avg_cycles, avg_time_us, (unsigned)input->bytes, num_iters);

    TfLiteTensor *output = interpreter.output(0);
    int8_t person_score = output->data.int8[1];
    int8_t no_person_score = output->data.int8[0];
    printk("Scores: person=%d no_person=%d (dummy input)\n\n", person_score, no_person_score);
}

static void bench_micro_speech(void) {
    const tflite::Model *model = tflite::GetModel(g_micro_speech_model);
    if (model->version() != TFLITE_SCHEMA_VERSION) {
        printk("ERROR: micro_speech model schema mismatch\n");
        return;
    }

    static tflite::MicroMutableOpResolver<4> resolver;
    resolver.AddReshape();
    resolver.AddFullyConnected();
    resolver.AddDepthwiseConv2D();
    resolver.AddSoftmax();

    tflite::MicroInterpreter interpreter(model, resolver, tensor_arena, kTensorArenaSize);
    if (interpreter.AllocateTensors() != kTfLiteOk) {
        printk("ERROR: micro_speech AllocateTensors() failed\n");
        return;
    }

    TfLiteTensor *input = interpreter.input(0);
    TfLiteTensor *output = interpreter.output(0);

    printk("Model loaded: micro_speech (size=%d bytes)\n", g_micro_speech_model_len);
    printk("Arena used: %zu / %d bytes\n", interpreter.arena_used_bytes(), kTensorArenaSize);

    const int num_inferences = 100;

    /* Fill with dummy MFCC features */
    memset(input->data.int8, 0, input->bytes);

    /* Warm up */
    interpreter.Invoke();

    /* Timed run — re-init DWT in case something disabled it */
    dwt_init();
    uint32_t t0 = dwt_start();
    for (int i = 0; i < num_inferences; i++) {
        interpreter.Invoke();
    }
    uint32_t total_cycles = dwt_stop(t0);
    uint32_t avg_cycles = total_cycles / num_inferences;
    uint32_t avg_time_us = dwt_cycles_to_us(avg_cycles, STM32N6_CPU_FREQ_HZ);

    printk("[ML_BENCH] model=micro_speech backend=cmsis_nn cycles=%u time_us=%u input=%u ops=INT8 inferences=%d\n",
           avg_cycles, avg_time_us, (unsigned)input->bytes, num_inferences);

    /* Print classification */
    printk("Output scores: [0]=%d [1]=%d [2]=%d [3]=%d\n\n",
           output->data.int8[0], output->data.int8[1],
           output->data.int8[2], output->data.int8[3]);
}

int main(void) {
    /* Delay to allow serial reader to connect after SRAM boot.
     * probe-rs holds the USB device during GDB boot — serial reader
     * can only open after probe-rs releases it (~2-3s). */
    k_msleep(5000);

    printk("=== STM32N6 ML Benchmark (NUCLEO-N657X0-Q) ===\n");
    printk("Board: NUCLEO-N657X0-Q\n");
    printk("CPU Frequency: %u Hz\n", STM32N6_CPU_FREQ_HZ);
    printk("Arena: %d bytes (%d KB)\n\n", kTensorArenaSize, kTensorArenaSize / 1024);

    dwt_init();
    printk("DWT profiler initialized\n\n");

    bench_sine();
    bench_person_detect();
    bench_micro_speech();

    printk("[ML_BENCH_DONE] board=nucleo_n657x0_q models=3\n");

    while (1) {
        k_msleep(1000);
    }
    return 0;
}
```

## src/dwt_profiler.h
```c
#ifndef DWT_PROFILER_H
#define DWT_PROFILER_H

#include <stdint.h>

/* ARM DWT registers */
#define DWT_CTRL   (*(volatile uint32_t *)0xE0001000)
#define DWT_CYCCNT (*(volatile uint32_t *)0xE0001004)
#define DEM_CR     (*(volatile uint32_t *)0xE000EDFC)

/* Enable DWT cycle counter */
static inline void dwt_init(void) {
    DEM_CR |= (1 << 24);      /* TRCENA bit in DEMCR */
    DWT_CYCCNT = 0;
    DWT_CTRL |= 1;            /* CYCCNTENA */
}

static inline void dwt_reset(void) {
    DWT_CTRL &= ~1;           /* Disable counter */
    DWT_CYCCNT = 0;
    DWT_CTRL |= 1;            /* Re-enable counter */
    __asm volatile("dsb" ::: "memory");
    __asm volatile("isb" ::: "memory");
}

static inline uint32_t dwt_get_cycles(void) {
    __asm volatile("dsb" ::: "memory");
    return DWT_CYCCNT;
}

/* Delta-based timing — avoids reset issues on some implementations */
static inline uint32_t dwt_start(void) {
    __asm volatile("dsb" ::: "memory");
    __asm volatile("isb" ::: "memory");
    return DWT_CYCCNT;
}

static inline uint32_t dwt_stop(uint32_t start) {
    __asm volatile("dsb" ::: "memory");
    return DWT_CYCCNT - start;  /* unsigned wrap handles overflow */
}

/* Convert cycles to microseconds given CPU freq in Hz */
static inline uint32_t dwt_cycles_to_us(uint32_t cycles, uint32_t cpu_freq_hz) {
    return (uint32_t)((uint64_t)cycles * 1000000ULL / cpu_freq_hz);
}

#endif
```

## src/ml_bench.c
```c
#include "ml_bench.h"
#include "dwt_profiler.h"
#include <stdio.h>
#include <string.h>

void ml_bench_print_result(const ml_bench_result_t *r) {
    /* Print NPU result */
    printk("[ML_BENCH] model=%s backend=npu cycles=%u time_us=%u input=%u ops=INT8\n",
           r->name, r->npu_cycles, r->npu_time_us, r->input_size);

    /* Print CPU result */
    printk("[ML_BENCH] model=%s backend=cpu cycles=%u time_us=%u input=%u ops=INT8\n",
           r->name, r->cpu_cycles, r->cpu_time_us, r->input_size);
}

void ml_bench_print_header(void) {
    printk("| Model          | NPU us   | CPU us   | Speedup | Size    |\n");
    printk("|----------------|----------|----------|---------|---------|\n");
}

void ml_bench_print_row(const ml_bench_result_t *r) {
    printk("| %-14s | %8u | %8u | %7.2f | %7u |\n",
           r->name, r->npu_time_us, r->cpu_time_us, r->speedup, r->model_size);
}

ml_bench_result_t ml_bench_run_dummy(const char *name, uint32_t input_bytes,
                                      uint32_t model_bytes, uint32_t iterations) {
    ml_bench_result_t result;

    memset(&result, 0, sizeof(result));
    strncpy(result.name, name, ML_BENCH_NAME_MAX - 1);
    result.name[ML_BENCH_NAME_MAX - 1] = '\0';
    result.input_size = input_bytes;
    result.model_size = model_bytes;
    result.npu_available = false;  /* Placeholder until NPU delegate is integrated */

    /* Simulate CPU-only inference with a dummy loop */
    volatile uint32_t dummy = 0;

    /* Time CPU-only execution */
    dwt_reset();
    for (uint32_t i = 0; i < iterations; i++) {
        /* Simulate some work proportional to input size */
        for (uint32_t j = 0; j < input_bytes; j++) {
            dummy++;
        }
    }
    result.cpu_cycles = dwt_get_cycles();
    result.cpu_time_us = dwt_cycles_to_us(result.cpu_cycles, STM32N6_CPU_FREQ_HZ);

    /* Simulate NPU execution with 600x speedup (placeholder for Neural-ART) */
    /* In Phase 2, this will be replaced with actual NPU delegate timing */
    result.npu_cycles = result.cpu_cycles / 600;
    if (result.npu_cycles == 0) {
        result.npu_cycles = 1;  /* Avoid division by zero */
    }
    result.npu_time_us = dwt_cycles_to_us(result.npu_cycles, STM32N6_CPU_FREQ_HZ);

    /* Calculate speedup */
    if (result.npu_time_us > 0) {
        result.speedup = (float)result.cpu_time_us / (float)result.npu_time_us;
    } else {
        result.speedup = 0.0f;
    }

    return result;
}
```

## src/ml_bench.cpp
```c
#include <zephyr/kernel.h>
#include "ml_bench.h"

void ml_bench_print_result(const ml_bench_result_t *r) {
    printk("[ML_BENCH] model=%s backend=%s cycles=%u time_us=%u input=%u ops=INT8\n",
           r->name,
           r->npu_available ? "npu" : "cpu",
           r->npu_available ? r->npu_cycles : r->cpu_cycles,
           r->npu_available ? r->npu_time_us : r->cpu_time_us,
           r->input_size);
}

void ml_bench_print_header(void) {
    printk("%-16s %10s %10s %10s %10s %8s\n",
           "Model", "CPU cyc", "CPU us", "NPU cyc", "NPU us", "Speedup");
    printk("%-16s %10s %10s %10s %10s %8s\n",
           "-----", "-------", "------", "-------", "------", "-------");
}

void ml_bench_print_row(const ml_bench_result_t *r) {
    if (r->npu_available) {
        printk("%-16s %10u %10u %10u %10u %7.1fx\n",
               r->name, r->cpu_cycles, r->cpu_time_us,
               r->npu_cycles, r->npu_time_us, (double)r->speedup);
    } else {
        printk("%-16s %10u %10u %10s %10s %8s\n",
               r->name, r->cpu_cycles, r->cpu_time_us,
               "N/A", "N/A", "N/A");
    }
}
```

## src/ml_bench.h
```c
#ifndef ML_BENCH_H
#define ML_BENCH_H

#ifdef __cplusplus
extern "C" {
#endif

#include <stdint.h>
#include <stdbool.h>

/* CPU frequency for STM32N6 (Cortex-M55 @ 600MHz) */
#define STM32N6_CPU_FREQ_HZ 600000000

/* Maximum model name length */
#define ML_BENCH_NAME_MAX 32

/* Benchmark result for one model */
typedef struct {
    char name[ML_BENCH_NAME_MAX];
    uint32_t input_size;       /* total input bytes */
    uint32_t model_size;       /* .tflite size in bytes */
    uint32_t npu_cycles;       /* DWT cycles with NPU */
    uint32_t cpu_cycles;       /* DWT cycles CPU-only */
    uint32_t npu_time_us;      /* inference time NPU (microseconds) */
    uint32_t cpu_time_us;      /* inference time CPU-only (microseconds) */
    float speedup;             /* cpu_time / npu_time */
    bool npu_available;        /* NPU delegate loaded successfully */
} ml_bench_result_t;

/* Print one result in EAB-parseable format */
void ml_bench_print_result(const ml_bench_result_t *r);

/* Print summary table header */
void ml_bench_print_header(void);

/* Print summary table row */
void ml_bench_print_row(const ml_bench_result_t *r);

#ifdef __cplusplus
}
#endif

#endif
```
