## CMakeLists.txt
```
cmake_minimum_required(VERSION 3.20.0)

find_package(Zephyr REQUIRED HINTS $ENV{ZEPHYR_BASE})
project(stm32n6_stress_test)

target_sources(app PRIVATE src/main.c)
```

## prj.conf
```kconfig
# nRF5340 Debug Full Example - Complete Debug Configuration
# Based on Zephyr tracing and shell samples with all debugging features

# ============= Thread Monitoring =============
CONFIG_THREAD_NAME=y
CONFIG_THREAD_MONITOR=y
CONFIG_THREAD_RUNTIME_STATS=y
CONFIG_THREAD_STACK_INFO=y
CONFIG_MP_MAX_NUM_CPUS=1

# ============= Debugging =============
CONFIG_DEBUG_OPTIMIZATIONS=n
CONFIG_DEBUG_THREAD_INFO=y

# ============= CTF Tracing =============
CONFIG_TRACING=y
CONFIG_TRACING_CTF=y
CONFIG_TRACING_CTF_TIMESTAMP=y
# RTT backend enabled via USE_SEGGER_RTT below

# ============= Coredump =============
CONFIG_DEBUG_COREDUMP=y
CONFIG_DEBUG_COREDUMP_BACKEND_LOGGING=y

# ============= SEGGER RTT =============
CONFIG_USE_SEGGER_RTT=y
CONFIG_SEGGER_RTT_MODE_BLOCK_IF_FIFO_FULL=y

# ============= Shell (Runtime Debug) =============
CONFIG_SHELL=y
CONFIG_SHELL_BACKEND_RTT=y
CONFIG_SHELL_RTT_RX_POLL_PERIOD=10
CONFIG_KERNEL_SHELL=y
CONFIG_SHELL_CMDS=y
CONFIG_SHELL_CMDS_RESIZE=y

# ============= Stack Protection =============
CONFIG_MPU_STACK_GUARD=y
# CONFIG_STACK_SENTINEL conflicts with MPU_STACK_GUARD

# ============= Assertions =============
CONFIG_ASSERT=y
CONFIG_ASSERT_LEVEL=2

# ============= Logging =============
CONFIG_LOG=y
CONFIG_LOG_MODE_DEFERRED=y
CONFIG_LOG_BACKEND_RTT=y
CONFIG_LOG_DEFAULT_LEVEL=3

# ============= Memory Management =============
CONFIG_HEAP_MEM_POOL_SIZE=16384

# ============= Random Number Generator =============
CONFIG_ENTROPY_GENERATOR=y
CONFIG_TEST_RANDOM_GENERATOR=y
```

## src/main.c
```c
/*
 * STM32-N6 High-Throughput Stress Test
 *
 * Streams continuous data via RTT (Real-Time Transfer) at maximum speed.
 * Outputs timestamped messages with sequence numbers for throughput/latency analysis.
 *
 * Transport: RTT (SEGGER Real-Time Transfer via ST-Link debug probe)
 * Expected throughput: TBD (first STM32-N6 benchmark)
 */

#include <zephyr/kernel.h>
#include <zephyr/sys/printk.h>
#include <zephyr/logging/log.h>

LOG_MODULE_REGISTER(stress_test, LOG_LEVEL_INF);

/* Configuration */
#define MESSAGE_SIZE    64      /* bytes per message */
#define BURST_COUNT     100     /* messages per burst */
#define BURST_DELAY_MS  10      /* delay between bursts */

/* Controlled test pattern - set via debugger */
volatile uint32_t test_enabled = 0;       /* Set to 1 via debugger to start */
volatile uint32_t sample_count = 0;       /* Current sample count */
volatile uint32_t samples_target = 1000000; /* Stop after 1M samples */

/* Statistics */
static uint32_t msg_count = 0;
static uint32_t byte_count = 0;
static uint64_t start_time_ms = 0;

static void print_stats(void)
{
    uint64_t now_ms = k_uptime_get();
    uint64_t elapsed_ms = now_ms - start_time_ms;

    if (elapsed_ms == 0) return;

    double elapsed_sec = elapsed_ms / 1000.0;
    double throughput_kbps = (byte_count / 1024.0) / elapsed_sec;
    double msg_rate = msg_count / elapsed_sec;

    printk("[STATS] msgs=%u bytes=%u uptime=%.1fs throughput=%.1f_KB/s rate=%.0f_msg/s\n",
           msg_count, byte_count, elapsed_sec, throughput_kbps, msg_rate);
}

static void stress_test_thread(void *p1, void *p2, void *p3)
{
    ARG_UNUSED(p1);
    ARG_UNUSED(p2);
    ARG_UNUSED(p3);

    char buffer[MESSAGE_SIZE];

    LOG_INF("STM32N6 Stress Test Ready");
    LOG_INF("Waiting for test_enabled=1 (set via debugger)...");
    LOG_INF("Target: %u samples", samples_target);

    /* Wait for test_enabled flag (set via debugger) */
    while (!test_enabled) {
        k_msleep(100);
    }

    start_time_ms = k_uptime_get();
    LOG_INF("Test starting...");
    LOG_INF("Message size: %d bytes", MESSAGE_SIZE);
    LOG_INF("Burst: %d messages every %d ms", BURST_COUNT, BURST_DELAY_MS);

    /* Run until target samples reached */
    while (sample_count < samples_target && test_enabled) {
        /* Burst of messages */
        for (int i = 0; i < BURST_COUNT && sample_count < samples_target; i++) {
            uint64_t timestamp_ms = k_uptime_get();

            int len = snprintf(buffer, MESSAGE_SIZE,
                             "[DATA] seq=%u t=%llu\n",
                             sample_count, timestamp_ms);

            /* Write to RTT */
            printk("%s", buffer);

            msg_count++;
            sample_count++;
            byte_count += len;
        }

        /* Print stats every 10 bursts (1 second at 10ms burst delay) */
        if ((msg_count % (BURST_COUNT * 10)) == 0) {
            print_stats();
        }

        k_msleep(BURST_DELAY_MS);
    }

    /* Test complete */
    print_stats();
    LOG_INF("Test complete!");
    LOG_INF("Total samples: %u", sample_count);
    test_enabled = 0;
    LOG_INF("Entering low-power idle mode...");

    /* Idle loop */
    while (1) {
        k_msleep(1000);
    }
}

K_THREAD_DEFINE(stress_test_tid, 2048,
                stress_test_thread, NULL, NULL, NULL,
                5, 0, 0);

int main(void)
{
    LOG_INF("STM32-N6 Stress Test Firmware");
    LOG_INF("Board: %s", CONFIG_BOARD);

    /* Main thread exits, stress_test_thread continues */
    return 0;
}
```
